VERSION "1.0"

NS_ :

BS_:

BU_: GENSET

BO_ 2364540032 EEC1: 8 GENSET
 SG_ ActualEnginePercentTorque : 16|8@1+ (1,-125) [-125|125] "%" Vector__XXX
 SG_ EngineSpeed : 24|16@1+ (0.125,0) [0|8031.875] "rpm" Vector__XXX

BO_ 2566844032 ET1: 8 GENSET
 SG_ EngineCoolantTemp : 0|8@1+ (1,-40) [-40|210] "degC" Vector__XXX

CM_ BU_ GENSET "Range extender engine ECU. J1939, preferred source address 0x80, arbitrary-address capable.";
CM_ BO_ 2364540032 "Electronic Engine Controller 1, PGN 61444.";
CM_ BO_ 2566844032 "Engine Temperature 1, PGN 65262.";

BA_DEF_ "ProtocolType" STRING ;
BA_DEF_ BO_ "VFrameFormat" ENUM "StandardCAN","ExtendedCAN","reserved","J1939PG";
BA_DEF_ BO_ "GenMsgCycleTime" INT 0 10000;
BA_DEF_ SG_ "SPN" INT 0 524287;
BA_DEF_DEF_ "ProtocolType" "";
BA_DEF_DEF_ "VFrameFormat" "J1939PG";
BA_DEF_DEF_ "GenMsgCycleTime" 0;
BA_DEF_DEF_ "SPN" 0;
BA_ "ProtocolType" "J1939";
BA_ "GenMsgCycleTime" BO_ 2364540032 100;
BA_ "GenMsgCycleTime" BO_ 2566844032 1000;
BA_ "SPN" SG_ 2364540032 ActualEnginePercentTorque 513;
BA_ "SPN" SG_ 2364540032 EngineSpeed 190;
BA_ "SPN" SG_ 2566844032 EngineCoolantTemp 110;
