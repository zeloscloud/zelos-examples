## lib/Kconfig
```kconfig
config ZELOS_CAN_BITRATE
	int "Bitrate of every node, bit/s"
	depends on CAN
	default 500000
	help
	  One value for every node on any board, whichever library drives
	  the controller. Zephyr's default when the devicetree is silent is
	  125 kbit/s, and Renode models no arbitration, so nodes at
	  different bitrates would work in simulation and fail on hardware.

rsource "can/Kconfig"
rsource "codec_bench/Kconfig"
rsource "xcp/Kconfig"
rsource "j1939/Kconfig"
rsource "canopen/Kconfig"
```

## lib/autosar/Kconfig
```kconfig
config ZELOS_AUTOSAR
	bool "AUTOSAR PDUs on CAN"
	depends on ZELOS_CAN
	select ZELOS_AUTOSAR_CORE
	select ZELOS_AUTOSAR_CMAC
	help
	  Sends the node's AUTOSAR I-PDUs on their timing: signals packed
	  from tables generated from arxml/can-full.arxml, E2E profiles 1, 2
	  and 5, a container I-PDU, a multiplexed I-PDU and a SecOC secured
	  I-PDU. See include/zelos/autosar.h.

config ZELOS_AUTOSAR_CORE
	bool "AUTOSAR COM core"
	select CRC
	help
	  Signal packing, E2E, container, multiplexed and SecOC framing
	  without I/O. ZELOS_AUTOSAR selects it; on its own it is only useful
	  to unit tests.

config ZELOS_AUTOSAR_CMAC
	bool "AES-128 CMAC for SecOC, through PSA Crypto"
	depends on ZELOS_AUTOSAR_CORE
	select PSA_CRYPTO
	select PSA_WANT_ALG_CMAC
	select PSA_WANT_KEY_TYPE_AES
	help
	  zelos_autosar_cmac(), on Zephyr's Mbed TLS. Needs the mbedtls and
	  tf-psa-crypto modules (west.yml) and an entropy source.

if ZELOS_AUTOSAR

config ZELOS_AUTOSAR_TX_MAX
	int "Most PDUs one schedule holds"
	range 1 64
	default 16

config ZELOS_AUTOSAR_STACK_SIZE
	int "Stack of the sending thread, bytes"
	default 3072
	help
	  The PDU builders run on it, the SecOC CMAC (PSA Crypto) among them.

endif # ZELOS_AUTOSAR
```

## lib/can/Kconfig
```kconfig
config ZELOS_CAN
	bool "CAN helper for the nodes"
	depends on CAN
	help
	  Owns the board's chosen CAN controller: brings it up once at
	  ZELOS_CAN_BITRATE, sends every protocol's frames through one
	  queue and routes received frames into queues.
	  See include/zelos/can.h.

if ZELOS_CAN

config ZELOS_CAN_TX_QUEUE_DEPTH
	int "Frames the transmit queue holds"
	range 1 255
	default 64
	help
	  Shared by every protocol on the node. Frames wait here, lowest
	  CAN identifier first, while the controller's own buffers are full.

config ZELOS_CAN_TX_MAX_AGE_MS
	int "Oldest frame the transmit thread still sends, in ms"
	range 1 60000
	default 1000
	help
	  A frame that waited longer, in the queue or for a controller
	  buffer, is dropped and counted as a transmit error. Without an
	  acknowledging node the queue fills; when one returns, it gets
	  current frames rather than a burst of stale ones. The frames
	  already in the controller's buffers still go out.

config ZELOS_CAN_TX_PRIORITY
	int "Priority of the transmit thread"
	default -1
	help
	  Above every sender, so a free controller buffer is refilled at
	  once. Cooperative by default, like the CANopen stack's own
	  transmit work queue it replaces.

endif # ZELOS_CAN
```

## lib/canopen/Kconfig
```kconfig
config ZELOS_CANOPEN
	bool "CANopen node runtime"
	depends on CAN
	select ZELOS_CAN
	select CANOPENNODE
	help
	  Runs the CANopenNode stack (the canopennodezephyr module) for a
	  node that builds its own object dictionary, od/CO_OD.c and
	  od/CO_OD.h. The stack shares the controller lib/can owns: its
	  driver here (CO_driver.c) sends through lib/can's queue and never
	  stops or reconfigures the controller. See include/zelos/canopen.h.

config ZELOS_CANOPEN_NODE_ID
	int "CANopen node-id"
	depends on ZELOS_CANOPEN
	range 1 127
	default 32
	help
	  0x20 puts the node's COB-IDs clear of the bench and XCP
	  identifiers: NMT 0x000, SYNC 0x080, EMCY 0x0A0, TPDO1 0x1A0,
	  RPDO1 0x220, TPDO2 0x2A0, RPDO2 0x320, TPDO3 0x3A0,
	  SDO 0x5A0/0x620, heartbeat 0x720. TIME is fixed at 0x100.
```

## lib/codec_bench/Kconfig
```kconfig
config ZELOS_CODEC_BENCH
	bool "Pack and unpack code for dbc/bench.dbc"
	help
	  The cantools codec for the bench's wire format, with the periods
	  from the DBC as BENCH_*_CYCLE_TIME_MS.
```

## lib/codec_genset/Kconfig
```kconfig
config ZELOS_CODEC_GENSET
	bool "Pack and unpack code for dbc/genset.dbc"
	help
	  The cantools codec for the genset's J1939 messages, with the
	  periods from the DBC as GENSET_*_CYCLE_TIME_MS.
```

## lib/doip/Kconfig
```kconfig
config ZELOS_DOIP
	bool "DoIP entity (ISO 13400-2) for the UDS server"
	depends on ZELOS_UDS && ZELOS_ETH && NET_TCP && NET_UDP && NET_SOCKETS
	select ZELOS_DOIP_CORE
	help
	  Vehicle identification, routing activation and diagnostic
	  messages on UDP and TCP 13400, into the UDS server CAN also
	  reaches. See include/zelos/doip.h.

config ZELOS_DOIP_CORE
	bool "DoIP protocol core"
	depends on ZELOS_UDS_CORE
	help
	  The entity's protocol logic without sockets. ZELOS_DOIP selects
	  it; on its own it is only useful to unit tests.

if ZELOS_DOIP

config ZELOS_DOIP_LOGICAL_ADDRESS
	hex "The entity's logical address"
	default 0x1001

config ZELOS_DOIP_FUNCTIONAL_ADDRESS
	hex "Functional logical address, as CAN's 0x7DF"
	default 0xe400

endif # ZELOS_DOIP
```

## lib/eth/Kconfig
```kconfig
config ZELOS_ETH
	bool "Ethernet link and a static IPv4 address"
	depends on NET_IPV4 && NET_L2_ETHERNET && NET_MGMT_EVENT && NET_STATISTICS_USER_API
	help
	  zelos_eth_start() sets ZELOS_ETH_IPV4_ADDR on the board's Ethernet
	  interface and returns without waiting for a link. See
	  include/zelos/eth.h; snippets/ethernet turns it on.

if ZELOS_ETH

config ZELOS_ETH_IPV4_ADDR
	string "Static IPv4 address"
	default "10.1.1.75"

config ZELOS_ETH_IPV4_NETMASK
	string "IPv4 netmask"
	default "255.255.255.0"

endif # ZELOS_ETH
```

## lib/goose/Kconfig
```kconfig
config ZELOS_GOOSE
	bool "IEC 61850 GOOSE publisher"
	depends on ZELOS_ETH && NET_SOCKETS && NET_SOCKETS_PACKET
	select ZELOS_GOOSE_CORE
	help
	  Control blocks on an AF_PACKET raw socket, on change or
	  periodic, from one thread. See include/zelos/goose.h;
	  snippets/goose turns it on.

config ZELOS_GOOSE_CORE
	bool "GOOSE publisher core"
	help
	  The schedule and frame encoder without sockets. ZELOS_GOOSE
	  selects it; on its own it is only useful to unit tests.
```

## lib/j1939/Kconfig
```kconfig
config ZELOS_J1939
	bool "SAE J1939 address claim, requests and broadcast transport"
	depends on ZELOS_CAN
	help
	  Claims a source address by NAME, answers requests, sends a node's
	  messages on their periods and anything longer than 8 bytes by
	  TP.BAM. See include/zelos/j1939.h.

config ZELOS_J1939_TICK_MS
	int "How often the J1939 thread runs, ms"
	depends on ZELOS_J1939
	default 10
	help
	  Bounds reply latency and the jitter on periodic messages and
	  BAM packet spacing.
```

## lib/reboot/Kconfig
```kconfig
config ZELOS_REBOOT
	bool "One orderly MCU reboot for every caller"
	select REBOOT
	help
	  zelos_reboot() runs the registered hook, then reboots. See
	  include/zelos/reboot.h.
```

## lib/someip/Kconfig
```kconfig
config ZELOS_SOMEIP
	bool "SOME/IP server with Service Discovery"
	depends on ZELOS_ETH && NET_UDP && NET_SOCKETS && NET_IPV4_IGMP
	select ZELOS_SOMEIP_CORE
	select ZELOS_REBOOT
	help
	  One service instance on UDP: events, fields (getter and
	  notifier), offered by SOME/IP-SD on 30490. See
	  include/zelos/someip.h.

config ZELOS_SOMEIP_CORE
	bool "SOME/IP protocol core"
	help
	  The server's protocol logic without sockets. ZELOS_SOMEIP selects
	  it; on its own it is only useful to unit tests.
```

## lib/uds/Kconfig
```kconfig
config ZELOS_UDS
	bool "UDS server on ISO-TP"
	depends on ZELOS_CAN
	select ZELOS_UDS_CORE
	select ISOTP
	select ZELOS_REBOOT
	select CSPRNG_NEEDED
	help
	  Answers a diagnostic tester (ISO 14229-1) over ISO-TP (ISO
	  15765-2, Zephyr's CONFIG_ISOTP) on the node's CAN bus: sessions,
	  security access, data identifiers, I/O control, routines, DTCs,
	  ECU reset and download into RAM. See include/zelos/uds.h.

config ZELOS_UDS_CORE
	bool "UDS protocol core"
	select CRC
	help
	  The protocol logic without a transport. ZELOS_UDS selects it; on
	  its own it is only useful to unit tests.

if ZELOS_UDS

config ZELOS_UDS_PHYS_ID
	hex "CAN identifier of physically addressed requests"
	default 0x7e0

config ZELOS_UDS_FUNC_ID
	hex "CAN identifier of functionally addressed requests"
	default 0x7df

config ZELOS_UDS_RESP_ID
	hex "CAN identifier of responses"
	default 0x7e8

config ZELOS_UDS_NVS
	bool "Permanent DTCs in flash"
	default y if ZELOS_UDS_OBD && $(dt_nodelabel_exists,storage_partition)
	select FLASH
	select FLASH_MAP
	select ZMS
	help
	  Keeps the permanent DTCs (OBD service 0x0A) in Zephyr Memory
	  Storage (ZMS) on the storage partition, so a power loss does not
	  erase them (13 CCR 1968.2 (g)(4.4.6)(C)). Written from a thread of
	  the lowest application priority whenever the set changes; read at
	  start.

endif # ZELOS_UDS

if ZELOS_UDS_CORE

config ZELOS_UDS_OBD
	bool "OBD-II responder (SAE J1979, J1979-2)"
	default y if ZELOS_UDS
	help
	  Answers SAE J1979 services 0x01-0x0A on the same identifiers, and
	  J1979-2 (OBDonUDS) DIDs 0xF4xx/0xF5xx/0xF8xx and ReadDTCInformation
	  0x42/0x55/0x56. Needs a VIN DID 0xF190 and the node's PID table.
	  See include/zelos/uds.h.

config ZELOS_UDS_OBD_VIN
	bool "Report the VIN"
	default y
	depends on ZELOS_UDS_OBD
	help
	  Service 0x09 infotype 0x02 and DID 0xF802. Only one ECU of a vehicle
	  reports the VIN (13 CCR 1968.2 (g)(4.8.1)): say n where the node is
	  not that ECU.

config ZELOS_UDS_DTC_CONFIRM_CYCLES
	int "Failed operation cycles before a DTC is confirmed"
	range 1 255
	default 2
	help
	  Consecutive cycles in which the test ran and failed. 2: pending at
	  the first, confirmed with the MIL at the second, as US OBD-II
	  requires (13 CCR 1968.2 (d)(2.2.2)).

config ZELOS_UDS_DTC_HEALING_CYCLES
	int "Passed operation cycles before the MIL goes off"
	range 1 255
	default 3
	help
	  Consecutive cycles in which the test ran and never failed (13 CCR
	  1968.2 (d)(2.3.2)).

config ZELOS_UDS_DTC_AGING_CYCLES
	int "Operation cycles with the MIL off before confirmedDTC is erased"
	range 1 255
	default 40
	help
	  Consecutive cycles without a failure. One operation cycle counts as
	  one warm-up cycle on this bench (13 CCR 1968.2 (d)(2.4)).

config ZELOS_UDS_BUF_SIZE
	int "Largest request or response, bytes"
	range 64 4095
	default 1026
	help
	  Also the maxNumberOfBlockLength RequestDownload and RequestUpload
	  report: a TransferData message, its SID and counter included. ISO-TP's
	  receive pool must hold one (ISOTP_RX_BUF_COUNT x ISOTP_RX_BUF_SIZE).

config ZELOS_UDS_DOWNLOAD_ADDRESS
	hex "Address of the download window"
	default 0x00100000
	help
	  Where RequestDownload, RequestUpload and the erase and check
	  routines address the RAM download buffer.

config ZELOS_UDS_DOWNLOAD_SIZE
	int "RAM download buffer, bytes"
	range 1 65536
	default 65536
	help
	  The download window's size. Never written to flash.

endif # ZELOS_UDS_CORE
```

## lib/xcp/Kconfig
```kconfig
config ZELOS_XCP
	bool "XCP on CAN slave"
	depends on ZELOS_CAN
	select ZELOS_XCP_CORE
	select POLL
	help
	  Answers an XCP master on the node's CAN bus: reads and calibration
	  writes restricted to the regions the application registers, and
	  dynamic DAQ sampled on the application's event channels.
	  See include/zelos/xcp.h.

config ZELOS_XCP_CORE
	bool "XCP protocol core"
	help
	  The protocol logic without a transport. ZELOS_XCP selects it; on
	  its own it is only useful to unit tests.

if ZELOS_XCP

config ZELOS_XCP_CRO_ID
	hex "CAN identifier of master-to-slave frames (CRO)"
	default 0x6f0

config ZELOS_XCP_DTO_ID
	hex "CAN identifier of slave-to-master frames (DTO)"
	default 0x6f1

endif # ZELOS_XCP

if ZELOS_XCP_CORE

# Static pools, shared by every DAQ list. Sized for a handful of variables.

config ZELOS_XCP_DAQ_LISTS
	int "DAQ lists"
	range 1 16
	default 2

config ZELOS_XCP_ODTS
	int "ODTs across all DAQ lists"
	range 1 64
	default 8
	help
	  Each ODT is one CAN frame per sample, carrying up to 7 bytes.

config ZELOS_XCP_ODT_ENTRIES
	int "ODT entries across all ODTs"
	range 1 255
	default 32

endif # ZELOS_XCP_CORE
```

## nodes/bms/sample.yaml
```yaml
sample:
  name: BMS node
common:
  platform_allow: nucleo_h753zi
  integration_platforms:
    - nucleo_h753zi
tests:
  zelos.nodes.bms: {}
```

## nodes/vcu/sample.yaml
```yaml
sample:
  name: VCU node
common:
  platform_allow: nucleo_h753zi
  integration_platforms:
    - nucleo_h753zi
tests:
  zelos.nodes.vcu: {}
```

## tests/lib/autosar/testcase.yaml
```yaml
tests:
  zelos.lib.autosar:
    platform_allow: native_sim/native/64
    integration_platforms:
      - native_sim/native/64
```

## tests/lib/can/testcase.yaml
```yaml
tests:
  zelos.lib.can:
    platform_allow: native_sim/native/64
    integration_platforms:
      - native_sim/native/64
```

## tests/lib/uds/testcase.yaml
```yaml
tests:
  zelos.lib.uds:
    platform_allow: native_sim/native/64
    integration_platforms:
      - native_sim/native/64
```

## tests/lib/uds_isotp/testcase.yaml
```yaml
tests:
  zelos.lib.uds_isotp:
    platform_allow: native_sim/native/64
    integration_platforms:
      - native_sim/native/64
```
