## CMakeLists.txt
```
cmake_minimum_required(VERSION 3.20.0)
find_package(Zephyr REQUIRED HINTS $ENV{ZEPHYR_BASE})
project(bench_dcdc)

target_sources(app PRIVATE src/main.c src/dcdc.c)
# Measurement and calibration over XCP, only with `-S xcp`. The build also
# writes zephyr/dcdc.a2l, dcdc.a2l with this build's addresses.
if(CONFIG_ZELOS_XCP)
  target_sources(app PRIVATE src/xcp.c)
  zelos_xcp_a2l(dcdc.a2l)
endif()
# Diagnostics over UDS, only with `-S uds`.
if(CONFIG_ZELOS_UDS)
  target_sources(app PRIVATE src/uds.c)
endif()
# AUTOSAR PDUs, only with `-S autosar`. autosar_pdus.c is generated from
# arxml/can-full.arxml: `just arxml`.
if(CONFIG_ZELOS_AUTOSAR)
  target_sources(app PRIVATE src/autosar.c src/autosar_pdus.c)
endif()
# A SOME/IP service, only with `-S ethernet` (and `-S uds`, for its field).
if(CONFIG_ZELOS_SOMEIP)
  target_sources(app PRIVATE src/someip.c)
endif()
```

## Kconfig
```
rsource "Kconfig.node"

source "Kconfig.zephyr"
```

## Kconfig.node
```
# The only difference between the bench's two builds of this node.

config BENCH_DCDC_HONOUR_LIMIT_IMMEDIATELY
	bool "Apply a reduced pack allowance immediately"
	default y
	help
	  When set, a reduction in BMS_Limits.AuxCurrentLimit takes effect at
	  once, and only increases in pack draw are rate-limited. The rate cap
	  protects the contactors and the input filter from inrush, which a
	  reduction does not cause.

	  When unset, the cap applies in both directions, so the converter
	  approaches a reduced allowance gradually instead of obeying it. Every
	  frame it sends remains legal and in range while it does.
```

## sample.yaml
```
sample:
  name: DC-DC node
common:
  platform_allow: nucleo_h753zi
  integration_platforms:
    - nucleo_h753zi
tests:
  zelos.nodes.dcdc: {}
  # The same source with its pack-allowance defect present. See Kconfig.
  zelos.nodes.dcdc.defect:
    extra_args: EXTRA_CONF_FILE=defect.conf
  # Measurement and calibration over XCP; see dcdc.a2l.
  zelos.nodes.dcdc.xcp:
    required_snippets:
      - xcp
  # Diagnostics over UDS; see src/uds.c.
  zelos.nodes.dcdc.uds:
    required_snippets:
      - uds
  # Both, as one ECU: a UDS reset ends the XCP session.
  zelos.nodes.dcdc.xcp_uds:
    required_snippets:
      - xcp
      - uds
  # AUTOSAR PDUs: E2E, container, multiplexed, secured; see arxml/can-full.arxml.
  zelos.nodes.dcdc.autosar:
    required_snippets:
      - autosar
```

## prj.conf
```kconfig
# Classic CAN, 8-byte frames, so the same DBC and firmware work against a
# physical adapter unchanged.
CONFIG_CAN=y

# Each node logs what it is on startup.
CONFIG_LOG=y

# The shared CAN helper and the codec generated from dbc/bench.dbc.
CONFIG_ZELOS_CAN=y
CONFIG_ZELOS_CODEC_BENCH=y
```

## defect.conf
```kconfig
# Build the DC-DC node with its pack-allowance defect present.
# Used by `just build dcdc-defect` in can-bench; see nodes/dcdc/Kconfig for what it changes.
CONFIG_BENCH_DCDC_HONOUR_LIMIT_IMMEDIATELY=n
```

## src/main.c
```c
#include <zelos/can.h>

#include "dcdc_node.h"

int main(void)
{
	if (zelos_can_init() == 0) {
		(void)dcdc_start();
	}

	return 0;
}
```

## src/autosar.c
```c
/*
 * The DC-DC's AUTOSAR PDUs, built with `-S autosar`.
 *
 * Ids, layouts, scaling, timing, E2E and SecOC parameters come from
 * arxml/can-full.arxml through the generated autosar_pdus.{c,h}; this file
 * only maps the model's state onto the signals. A PDU the ARXML adds without a
 * build_<name>() here fails the build.
 *
 * Every frame carries one model sample (50 ms loop): the same values as a
 * DCDC_Status of that sample, to each signal's resolution. UDS
 * CommunicationControl stops these with the node's other normal messages.
 */

#include "autosar.h"

#include <zelos/autosar.h>

#include <zephyr/drivers/can.h>
#include <zephyr/kernel.h>
#include <zephyr/logging/log.h>
#include <zephyr/sys/util.h>

#include "autosar_pdus.h"

LOG_MODULE_REGISTER(dcdc_autosar, LOG_LEVEL_INF);

/*
 * SecOC key of DcdcSecured: the AES-128 example key of RFC 4493, public on
 * purpose. A demo key; real keys come from a key manager, never from the ARXML.
 */
static const uint8_t secoc_key[16] = {0x2B, 0x7E, 0x15, 0x16, 0x28, 0xAE, 0xD2, 0xA6,
				      0xAB, 0xF7, 0x15, 0x88, 0x09, 0xCF, 0x4F, 0x3C};

/* DcdcState: one compu method in the ARXML, so the same codes in every PDU. */
enum {
	IDLE = AR_DCDC_OUTPUT_P1_DCDC_STATE_IDLE,
	CONVERTING = AR_DCDC_OUTPUT_P1_DCDC_STATE_CONVERTING,
	DERATING = AR_DCDC_OUTPUT_P1_DCDC_STATE_DERATING
};
#define SAME_STATES(PDU)                                                                           \
	BUILD_ASSERT(AR_##PDU##_DCDC_STATE_IDLE == IDLE &&                                         \
		     AR_##PDU##_DCDC_STATE_CONVERTING == CONVERTING &&                             \
		     AR_##PDU##_DCDC_STATE_DERATING == DERATING)
SAME_STATES(DCDC_HEALTH);
SAME_STATES(DCDC_MUX_STATIC);

/* The latest sample, written by the model's loop, read by the AUTOSAR thread. */
static struct k_spinlock lock;
static struct dcdc_state latest;
static uint8_t latest_state;
/* False until the first sample, and while CommunicationControl disables tx. */
static bool sending;

/* E2E counters and the SecOC freshness value, one per PDU. */
static uint8_t p1_counter;
static uint8_t p2_counter;
static uint8_t p5_counter;
static uint8_t freshness;

void dcdc_autosar_sample(const struct dcdc_state *state, bool derating, bool tx)
{
	const uint8_t mode = derating ? DERATING : state->input_a > 0.0f ? CONVERTING : IDLE;

	K_SPINLOCK(&lock) {
		latest = *state;
		latest_state = mode;
		sending = tx;
	}
}

/* This frame's sample, or false: nothing to send. */
static bool take(struct dcdc_state *s, uint8_t *mode)
{
	bool tx;

	K_SPINLOCK(&lock) {
		*s = latest;
		*mode = latest_state;
		tx = sending;
	}
	return tx;
}

/* --- E2E protected ------------------------------------------------------- */

static uint8_t build_dcdc_output_p1(uint8_t *data)
{
	struct dcdc_state s;
	uint8_t mode;

	if (!take(&s, &mode)) {
		return 0;
	}
	zelos_ar_init(data, &ar_dcdc_output_p1);
	zelos_ar_pack(data, &ar_dcdc_output_p1_dcdc_state, mode);
	zelos_ar_set(data, &ar_dcdc_output_p1_output_voltage, s.output_v);
	zelos_ar_set(data, &ar_dcdc_output_p1_output_current, s.output_a);
	zelos_ar_set(data, &ar_dcdc_output_p1_input_current, s.input_a);
	zelos_e2e_p01_protect(&ar_dcdc_output_p1_e2e, &p1_counter, data);
	return ar_dcdc_output_p1.length;
}

static uint8_t build_dcdc_thermal_p2(uint8_t *data)
{
	struct dcdc_state s;
	uint8_t mode;

	if (!take(&s, &mode)) {
		return 0;
	}
	zelos_ar_init(data, &ar_dcdc_thermal_p2);
	zelos_ar_set(data, &ar_dcdc_thermal_p2_temperature, s.temperature_c);
	zelos_ar_pack(data, &ar_dcdc_thermal_p2_derate_active,
		      mode == DERATING ? AR_DCDC_THERMAL_P2_DERATE_ACTIVE_ACTIVE
				       : AR_DCDC_THERMAL_P2_DERATE_ACTIVE_INACTIVE);
	zelos_ar_set(data, &ar_dcdc_thermal_p2_aux_current_limit, s.aux_limit_a);
	zelos_e2e_p02_protect(&ar_dcdc_thermal_p2_e2e, &p2_counter, data);
	return ar_dcdc_thermal_p2.length;
}

static uint8_t build_dcdc_power_p5(uint8_t *data)
{
	struct dcdc_state s;
	uint8_t mode;

	if (!take(&s, &mode)) {
		return 0;
	}
	zelos_ar_init(data, &ar_dcdc_power_p5);
	zelos_ar_set(data, &ar_dcdc_power_p5_output_power, s.output_v * s.output_a);
	zelos_ar_set(data, &ar_dcdc_power_p5_input_voltage, s.input_v); /* NaN: Unknown */
	zelos_ar_set(data, &ar_dcdc_power_p5_setpoint_voltage, s.setpoint_v);
	zelos_e2e_p05_protect(&ar_dcdc_power_p5_e2e, &p5_counter, data);
	return ar_dcdc_power_p5.length;
}

/* --- Contained in DcdcContainer, one per frame ---------------------------- */

static uint8_t build_dcdc_rail(uint8_t *data)
{
	struct dcdc_state s;
	uint8_t mode;
	uint8_t pdu[CAN_MAX_DLEN];

	if (!take(&s, &mode)) {
		return 0;
	}
	zelos_ar_init(pdu, &ar_dcdc_rail);
	zelos_ar_set(pdu, &ar_dcdc_rail_output_voltage, s.output_v);
	zelos_ar_set(pdu, &ar_dcdc_rail_output_current, s.output_a);
	return zelos_ar_contain(data, AR_DCDC_RAIL_HEADER_ID, pdu, ar_dcdc_rail.length);
}

static uint8_t build_dcdc_input(uint8_t *data)
{
	struct dcdc_state s;
	uint8_t mode;
	uint8_t pdu[CAN_MAX_DLEN];

	if (!take(&s, &mode)) {
		return 0;
	}
	zelos_ar_init(pdu, &ar_dcdc_input);
	zelos_ar_set(pdu, &ar_dcdc_input_input_current, s.input_a);
	zelos_ar_set(pdu, &ar_dcdc_input_input_voltage, s.input_v);
	return zelos_ar_contain(data, AR_DCDC_INPUT_HEADER_ID, pdu, ar_dcdc_input.length);
}

static uint8_t build_dcdc_health(uint8_t *data)
{
	struct dcdc_state s;
	uint8_t mode;
	uint8_t pdu[CAN_MAX_DLEN];

	if (!take(&s, &mode)) {
		return 0;
	}
	zelos_ar_init(pdu, &ar_dcdc_health);
	zelos_ar_set(pdu, &ar_dcdc_health_temperature, s.temperature_c);
	zelos_ar_pack(pdu, &ar_dcdc_health_dcdc_state, mode);
	/* Seconds since boot, wrapping at 16 bits. */
	zelos_ar_pack(pdu, &ar_dcdc_health_uptime_s, (s.uptime_ms / 1000U) & 0xFFFFU);
	return zelos_ar_contain(data, AR_DCDC_HEALTH_HEADER_ID, pdu, ar_dcdc_health.length);
}

/* --- DcdcMux: the static part, and one dynamic part per frame -------------- */

/* The multiplexed PDU with its static part in place. */
static void mux_static(uint8_t *data, const struct dcdc_state *s, uint8_t mode)
{
	uint8_t part[CAN_MAX_DLEN];

	zelos_ar_init(data, &ar_dcdc_mux);
	zelos_ar_init(part, &ar_dcdc_mux_static);
	zelos_ar_pack(part, &ar_dcdc_mux_static_dcdc_state, mode);
	zelos_ar_set(part, &ar_dcdc_mux_static_output_voltage, s->output_v);
	zelos_ar_merge(data, part, ar_dcdc_mux_static_segments,
		       ARRAY_SIZE(ar_dcdc_mux_static_segments));
}

static uint8_t build_dcdc_mux_currents(uint8_t *data)
{
	struct dcdc_state s;
	uint8_t mode;
	uint8_t part[CAN_MAX_DLEN];

	if (!take(&s, &mode)) {
		return 0;
	}
	mux_static(data, &s, mode);
	zelos_ar_init(part, &ar_dcdc_mux_currents);
	zelos_ar_pack(part, &ar_dcdc_mux_selector, AR_DCDC_MUX_CURRENTS_SELECTOR);
	zelos_ar_set(part, &ar_dcdc_mux_currents_output_current, s.output_a);
	zelos_ar_set(part, &ar_dcdc_mux_currents_input_current, s.input_a);
	zelos_ar_merge(data, part, ar_dcdc_mux_dynamic_segments,
		       ARRAY_SIZE(ar_dcdc_mux_dynamic_segments));
	return ar_dcdc_mux.length;
}

static uint8_t build_dcdc_mux_limits(uint8_t *data)
{
	struct dcdc_state s;
	uint8_t mode;
	uint8_t part[CAN_MAX_DLEN];

	if (!take(&s, &mode)) {
		return 0;
	}
	mux_static(data, &s, mode);
	zelos_ar_init(part, &ar_dcdc_mux_limits);
	zelos_ar_pack(part, &ar_dcdc_mux_selector, AR_DCDC_MUX_LIMITS_SELECTOR);
	zelos_ar_set(part, &ar_dcdc_mux_limits_aux_current_limit, s.aux_limit_a);
	zelos_ar_set(part, &ar_dcdc_mux_limits_setpoint_voltage, s.setpoint_v);
	zelos_ar_merge(data, part, ar_dcdc_mux_dynamic_segments,
		       ARRAY_SIZE(ar_dcdc_mux_dynamic_segments));
	return ar_dcdc_mux.length;
}

/* --- DcdcSecured: SecOC profile 1 ----------------------------------------- */

BUILD_ASSERT(AR_DCDC_SECURED_LENGTH <= CAN_MAX_DLEN);

static uint8_t build_dcdc_secured_payload(uint8_t *data)
{
	struct dcdc_state s;
	uint8_t mode;
	uint8_t auth[2 + CAN_MAX_DLEN + AR_DCDC_SECURED_FRESHNESS_BITS / 8];
	uint8_t mac[16];
	size_t len;

	if (!take(&s, &mode)) {
		return 0;
	}
	zelos_ar_init(data, &ar_dcdc_secured_payload);
	zelos_ar_set(data, &ar_dcdc_secured_payload_output_voltage, s.output_v);
	zelos_ar_set(data, &ar_dcdc_secured_payload_input_current, s.input_a);

	len = zelos_secoc_auth_data(auth, AR_DCDC_SECURED_DATA_ID, data,
				    ar_dcdc_secured_payload.length, freshness,
				    AR_DCDC_SECURED_FRESHNESS_BITS);
	if (zelos_autosar_cmac(secoc_key, auth, len, mac) != 0) {
		/* No authenticator, no frame: a gap on the bus, never a bad MAC. */
		LOG_ERR_RATELIMIT("SecOC CMAC failed");
		return 0;
	}
	zelos_secoc_trailer(data, ar_dcdc_secured_payload.length, freshness,
			    AR_DCDC_SECURED_FRESHNESS_TX_BITS, mac, AR_DCDC_SECURED_AUTH_TX_BITS);
	/* After the PDU is built (SWS_SecOC_00031 step 5); 8 bits wrap. */
	freshness++;
	return AR_DCDC_SECURED_LENGTH;
}

/* --- Schedule -------------------------------------------------------------- */

#define ENTRY(name, NAME)                                                                          \
	{AR_##NAME##_ID, AR_##NAME##_PERIOD_MS, AR_##NAME##_OFFSET_MS, build_##name},

static const struct zelos_ar_tx schedule[] = {AR_TX_PDUS(ENTRY)};

BUILD_ASSERT(ARRAY_SIZE(schedule) <= CONFIG_ZELOS_AUTOSAR_TX_MAX,
	     "raise CONFIG_ZELOS_AUTOSAR_TX_MAX");

int dcdc_autosar_start(void)
{
	return zelos_autosar_start(schedule, ARRAY_SIZE(schedule));
}
```

## src/autosar.h
```c
/* The DC-DC's AUTOSAR PDUs, built with `-S autosar`. */

#ifndef DCDC_AUTOSAR_H_
#define DCDC_AUTOSAR_H_

#include <stdbool.h>

#include "state.h"

int dcdc_autosar_start(void);

/*
 * Publish this cycle's state. derating: above the derate temperature. tx: the
 * node sends its normal messages (UDS CommunicationControl), these included.
 */
void dcdc_autosar_sample(const struct dcdc_state *state, bool derating, bool tx);

#endif /* DCDC_AUTOSAR_H_ */
```

## src/autosar_pdus.c
```c
/*
 * DCDC's AUTOSAR I-PDUs: generated by tools/arxml2c.py from arxml/can-full.arxml.
 * Do not edit: change the ARXML and run `just arxml`. See include/zelos/autosar.h.
 */

#include "autosar_pdus.h"

const struct zelos_ar_pdu ar_dcdc_output_p1 = {.length = 8, .unused = 0xFF};
const struct zelos_ar_signal ar_dcdc_output_p1_crc = {.start = 0, .length = 8, .factor = 1.0f, .offset = 0.0f, .min = 0, .max = 255};
const struct zelos_ar_signal ar_dcdc_output_p1_counter = {.start = 8, .length = 4, .factor = 1.0f, .offset = 0.0f, .min = 0, .max = 15};
const struct zelos_ar_signal ar_dcdc_output_p1_dcdc_state = {.start = 12, .length = 4, .factor = 1.0f, .offset = 0.0f, .min = 0, .max = 15};
const struct zelos_ar_signal ar_dcdc_output_p1_output_voltage = {.start = 16, .length = 16, .factor = 0.001f, .offset = 0.0f, .min = 0, .max = 65535};
const struct zelos_ar_signal ar_dcdc_output_p1_output_current = {.start = 32, .length = 16, .factor = 0.05f, .offset = 0.0f, .min = 0, .max = 65535};
const struct zelos_ar_signal ar_dcdc_output_p1_input_current = {.start = 48, .length = 16, .factor = 0.001f, .offset = 0.0f, .min = 0, .max = 65535};
const struct zelos_e2e_p01_config ar_dcdc_output_p1_e2e = {.data_id = 0x0310, .data_id_mode = ZELOS_E2E_P01_DATAID_BOTH, .counter_offset = 8, .crc_offset = 0, .data_id_nibble_offset = 0, .data_length = 64};
const struct zelos_ar_pdu ar_dcdc_thermal_p2 = {.length = 8, .unused = 0xFF};
const struct zelos_ar_signal ar_dcdc_thermal_p2_crc = {.start = 0, .length = 8, .factor = 1.0f, .offset = 0.0f, .min = 0, .max = 255};
const struct zelos_ar_signal ar_dcdc_thermal_p2_counter = {.start = 8, .length = 4, .factor = 1.0f, .offset = 0.0f, .min = 0, .max = 15};
const struct zelos_ar_signal ar_dcdc_thermal_p2_temperature = {.start = 16, .length = 16, .factor = 0.1f, .offset = 0.0f, .min = -400, .max = 2150};
const struct zelos_ar_signal ar_dcdc_thermal_p2_derate_active = {.start = 32, .length = 1, .factor = 1.0f, .offset = 0.0f, .min = 0, .max = 1};
const struct zelos_ar_signal ar_dcdc_thermal_p2_aux_current_limit = {.start = 40, .length = 16, .factor = 0.01f, .offset = 0.0f, .min = 0, .max = 65535};
const struct zelos_e2e_p02_config ar_dcdc_thermal_p2_e2e = {.data_ids = {0x30, 0x31, 0x32, 0x33, 0x34, 0x35, 0x36, 0x37, 0x38, 0x39, 0x3A, 0x3B, 0x3C, 0x3D, 0x3E, 0x3F}, .data_length = 64};
const struct zelos_ar_pdu ar_dcdc_power_p5 = {.length = 8, .unused = 0xFF};
const struct zelos_ar_signal ar_dcdc_power_p5_crc = {.start = 0, .length = 16, .factor = 1.0f, .offset = 0.0f, .min = 0, .max = 65535};
const struct zelos_ar_signal ar_dcdc_power_p5_counter = {.start = 16, .length = 8, .factor = 1.0f, .offset = 0.0f, .min = 0, .max = 255};
const struct zelos_ar_signal ar_dcdc_power_p5_output_power = {.start = 24, .length = 16, .factor = 1.0f, .offset = 0.0f, .min = 0, .max = 65535};
const struct zelos_ar_signal ar_dcdc_power_p5_input_voltage = {.start = 40, .length = 16, .factor = 0.1f, .offset = 0.0f, .min = 0, .max = 65534, .has_invalid = true, .invalid = 0xFFFF};
const struct zelos_ar_signal ar_dcdc_power_p5_setpoint_voltage = {.start = 56, .length = 8, .factor = 0.1f, .offset = 0.0f, .min = 0, .max = 255};
const struct zelos_e2e_p05_config ar_dcdc_power_p5_e2e = {.data_id = 0x0312, .offset = 0, .data_length = 64};
const struct zelos_ar_pdu ar_dcdc_rail = {.length = 4, .unused = 0xFF};
const struct zelos_ar_signal ar_dcdc_rail_output_voltage = {.start = 0, .length = 16, .factor = 0.01f, .offset = 0.0f, .min = 0, .max = 65535};
const struct zelos_ar_signal ar_dcdc_rail_output_current = {.start = 16, .length = 16, .factor = 0.1f, .offset = 0.0f, .min = 0, .max = 65535};
const struct zelos_ar_pdu ar_dcdc_input = {.length = 4, .unused = 0xFF};
const struct zelos_ar_signal ar_dcdc_input_input_current = {.start = 0, .length = 16, .factor = 0.01f, .offset = 0.0f, .min = 0, .max = 65535};
const struct zelos_ar_signal ar_dcdc_input_input_voltage = {.start = 16, .length = 16, .factor = 0.1f, .offset = 0.0f, .min = 0, .max = 65534, .has_invalid = true, .invalid = 0xFFFF};
const struct zelos_ar_pdu ar_dcdc_health = {.length = 4, .unused = 0xFF};
const struct zelos_ar_signal ar_dcdc_health_temperature = {.start = 0, .length = 8, .factor = 1.0f, .offset = -40.0f, .min = 0, .max = 255};
const struct zelos_ar_signal ar_dcdc_health_dcdc_state = {.start = 8, .length = 8, .factor = 1.0f, .offset = 0.0f, .min = 0, .max = 255};
const struct zelos_ar_signal ar_dcdc_health_uptime_s = {.start = 16, .length = 16, .factor = 1.0f, .offset = 0.0f, .min = 0, .max = 65535};
const struct zelos_ar_pdu ar_dcdc_mux = {.length = 8, .unused = 0xFF};
const struct zelos_ar_segment ar_dcdc_mux_static_segments[1] = {{8, 24}};
const struct zelos_ar_segment ar_dcdc_mux_dynamic_segments[2] = {{0, 8}, {32, 32}};
const struct zelos_ar_pdu ar_dcdc_mux_static = {.length = 8, .unused = 0xFF};
const struct zelos_ar_signal ar_dcdc_mux_selector = {.start = 0, .length = 8, .factor = 1.0f, .offset = 0.0f, .min = 0, .max = 255};
const struct zelos_ar_signal ar_dcdc_mux_static_dcdc_state = {.start = 8, .length = 8, .factor = 1.0f, .offset = 0.0f, .min = 0, .max = 255};
const struct zelos_ar_signal ar_dcdc_mux_static_output_voltage = {.start = 16, .length = 16, .factor = 0.01f, .offset = 0.0f, .min = 0, .max = 65535};
const struct zelos_ar_pdu ar_dcdc_mux_currents = {.length = 8, .unused = 0xFF};
const struct zelos_ar_signal ar_dcdc_mux_currents_output_current = {.start = 32, .length = 16, .factor = 0.1f, .offset = 0.0f, .min = 0, .max = 65535};
const struct zelos_ar_signal ar_dcdc_mux_currents_input_current = {.start = 48, .length = 16, .factor = 0.01f, .offset = 0.0f, .min = 0, .max = 65535};
const struct zelos_ar_pdu ar_dcdc_mux_limits = {.length = 8, .unused = 0xFF};
const struct zelos_ar_signal ar_dcdc_mux_limits_aux_current_limit = {.start = 32, .length = 16, .factor = 0.01f, .offset = 0.0f, .min = 0, .max = 65535};
const struct zelos_ar_signal ar_dcdc_mux_limits_setpoint_voltage = {.start = 48, .length = 16, .factor = 0.01f, .offset = 0.0f, .min = 0, .max = 65535};
const struct zelos_ar_pdu ar_dcdc_secured_payload = {.length = 4, .unused = 0xFF};
const struct zelos_ar_signal ar_dcdc_secured_payload_output_voltage = {.start = 0, .length = 16, .factor = 0.01f, .offset = 0.0f, .min = 0, .max = 65535};
const struct zelos_ar_signal ar_dcdc_secured_payload_input_current = {.start = 16, .length = 16, .factor = 0.01f, .offset = 0.0f, .min = 0, .max = 65535};
```

## src/autosar_pdus.h
```c
/*
 * DCDC's AUTOSAR I-PDUs: generated by tools/arxml2c.py from arxml/can-full.arxml.
 * Do not edit: change the ARXML and run `just arxml`. See include/zelos/autosar.h.
 */

#ifndef AUTOSAR_PDUS_H_
#define AUTOSAR_PDUS_H_

#include <zelos/autosar.h>

/* Every I-PDU DCDC sends on its own timing, as X(name, NAME). */
#define AR_TX_PDUS(X) \
	X(dcdc_output_p1, DCDC_OUTPUT_P1) \
	X(dcdc_thermal_p2, DCDC_THERMAL_P2) \
	X(dcdc_power_p5, DCDC_POWER_P5) \
	X(dcdc_rail, DCDC_RAIL) \
	X(dcdc_input, DCDC_INPUT) \
	X(dcdc_health, DCDC_HEALTH) \
	X(dcdc_mux_currents, DCDC_MUX_CURRENTS) \
	X(dcdc_mux_limits, DCDC_MUX_LIMITS) \
	X(dcdc_secured_payload, DCDC_SECURED_PAYLOAD)

/* DcdcOutputP1: frame 0x310, I-SIGNAL-I-PDU. Rail output and pack current, E2E profile 1. */
extern const struct zelos_ar_pdu ar_dcdc_output_p1;
#define AR_DCDC_OUTPUT_P1_ID 0x310
#define AR_DCDC_OUTPUT_P1_PERIOD_MS 20
#define AR_DCDC_OUTPUT_P1_OFFSET_MS 0
extern const struct zelos_ar_signal ar_dcdc_output_p1_crc;
extern const struct zelos_ar_signal ar_dcdc_output_p1_counter;
extern const struct zelos_ar_signal ar_dcdc_output_p1_dcdc_state;
#define AR_DCDC_OUTPUT_P1_DCDC_STATE_IDLE 0
#define AR_DCDC_OUTPUT_P1_DCDC_STATE_CONVERTING 1
#define AR_DCDC_OUTPUT_P1_DCDC_STATE_DERATING 2
extern const struct zelos_ar_signal ar_dcdc_output_p1_output_voltage;
extern const struct zelos_ar_signal ar_dcdc_output_p1_output_current;
extern const struct zelos_ar_signal ar_dcdc_output_p1_input_current;
extern const struct zelos_e2e_p01_config ar_dcdc_output_p1_e2e;

/* DcdcThermalP2: frame 0x311, I-SIGNAL-I-PDU. Thermal state and the pack allowance, E2E profile 2. */
extern const struct zelos_ar_pdu ar_dcdc_thermal_p2;
#define AR_DCDC_THERMAL_P2_ID 0x311
#define AR_DCDC_THERMAL_P2_PERIOD_MS 50
#define AR_DCDC_THERMAL_P2_OFFSET_MS 0
extern const struct zelos_ar_signal ar_dcdc_thermal_p2_crc;
extern const struct zelos_ar_signal ar_dcdc_thermal_p2_counter;
extern const struct zelos_ar_signal ar_dcdc_thermal_p2_temperature;
extern const struct zelos_ar_signal ar_dcdc_thermal_p2_derate_active;
#define AR_DCDC_THERMAL_P2_DERATE_ACTIVE_INACTIVE 0
#define AR_DCDC_THERMAL_P2_DERATE_ACTIVE_ACTIVE 1
extern const struct zelos_ar_signal ar_dcdc_thermal_p2_aux_current_limit;
extern const struct zelos_e2e_p02_config ar_dcdc_thermal_p2_e2e;

/* DcdcPowerP5: frame 0x312, I-SIGNAL-I-PDU. Power, pack voltage and setpoint, E2E profile 5. */
extern const struct zelos_ar_pdu ar_dcdc_power_p5;
#define AR_DCDC_POWER_P5_ID 0x312
#define AR_DCDC_POWER_P5_PERIOD_MS 20
#define AR_DCDC_POWER_P5_OFFSET_MS 0
extern const struct zelos_ar_signal ar_dcdc_power_p5_crc;
extern const struct zelos_ar_signal ar_dcdc_power_p5_counter;
extern const struct zelos_ar_signal ar_dcdc_power_p5_output_power;
extern const struct zelos_ar_signal ar_dcdc_power_p5_input_voltage;
#define AR_DCDC_POWER_P5_INPUT_VOLTAGE_UNKNOWN 65535
extern const struct zelos_ar_signal ar_dcdc_power_p5_setpoint_voltage;
extern const struct zelos_e2e_p05_config ar_dcdc_power_p5_e2e;

/* DcdcContainer: frame 0x313, CONTAINER-I-PDU. Dynamic container, short headers: one contained PDU per frame. */
#define AR_DCDC_CONTAINER_ID 0x313
/* DcdcRail: contained in DcdcContainer. Contained: the 12 V rail. */
extern const struct zelos_ar_pdu ar_dcdc_rail;
#define AR_DCDC_RAIL_ID 0x313
#define AR_DCDC_RAIL_PERIOD_MS 60
#define AR_DCDC_RAIL_OFFSET_MS 0
#define AR_DCDC_RAIL_HEADER_ID 0x100001
extern const struct zelos_ar_signal ar_dcdc_rail_output_voltage;
extern const struct zelos_ar_signal ar_dcdc_rail_output_current;
/* DcdcInput: contained in DcdcContainer. Contained: the pack side. */
extern const struct zelos_ar_pdu ar_dcdc_input;
#define AR_DCDC_INPUT_ID 0x313
#define AR_DCDC_INPUT_PERIOD_MS 60
#define AR_DCDC_INPUT_OFFSET_MS 20
#define AR_DCDC_INPUT_HEADER_ID 0x100002
extern const struct zelos_ar_signal ar_dcdc_input_input_current;
extern const struct zelos_ar_signal ar_dcdc_input_input_voltage;
#define AR_DCDC_INPUT_INPUT_VOLTAGE_UNKNOWN 65535
/* DcdcHealth: contained in DcdcContainer. Contained: temperature, state and uptime. */
extern const struct zelos_ar_pdu ar_dcdc_health;
#define AR_DCDC_HEALTH_ID 0x313
#define AR_DCDC_HEALTH_PERIOD_MS 60
#define AR_DCDC_HEALTH_OFFSET_MS 40
#define AR_DCDC_HEALTH_HEADER_ID 0x100003
extern const struct zelos_ar_signal ar_dcdc_health_temperature;
extern const struct zelos_ar_signal ar_dcdc_health_dcdc_state;
#define AR_DCDC_HEALTH_DCDC_STATE_IDLE 0
#define AR_DCDC_HEALTH_DCDC_STATE_CONVERTING 1
#define AR_DCDC_HEALTH_DCDC_STATE_DERATING 2
extern const struct zelos_ar_signal ar_dcdc_health_uptime_s;

/* DcdcMux: frame 0x314, MULTIPLEXED-I-PDU. Multiplexed: state and voltage always, currents and limits in turn. */
#define AR_DCDC_MUX_ID 0x314
extern const struct zelos_ar_pdu ar_dcdc_mux;
extern const struct zelos_ar_segment ar_dcdc_mux_static_segments[1];
extern const struct zelos_ar_segment ar_dcdc_mux_dynamic_segments[2];
/* DcdcMuxStatic: static part of DcdcMux. */
extern const struct zelos_ar_pdu ar_dcdc_mux_static;
extern const struct zelos_ar_signal ar_dcdc_mux_selector;
extern const struct zelos_ar_signal ar_dcdc_mux_static_dcdc_state;
#define AR_DCDC_MUX_STATIC_DCDC_STATE_IDLE 0
#define AR_DCDC_MUX_STATIC_DCDC_STATE_CONVERTING 1
#define AR_DCDC_MUX_STATIC_DCDC_STATE_DERATING 2
extern const struct zelos_ar_signal ar_dcdc_mux_static_output_voltage;
/* DcdcMuxCurrents: dynamic part of DcdcMux, selector 0. */
extern const struct zelos_ar_pdu ar_dcdc_mux_currents;
#define AR_DCDC_MUX_CURRENTS_ID 0x314
#define AR_DCDC_MUX_CURRENTS_PERIOD_MS 100
#define AR_DCDC_MUX_CURRENTS_OFFSET_MS 0
#define AR_DCDC_MUX_CURRENTS_SELECTOR 0
extern const struct zelos_ar_signal ar_dcdc_mux_currents_output_current;
extern const struct zelos_ar_signal ar_dcdc_mux_currents_input_current;
/* DcdcMuxLimits: dynamic part of DcdcMux, selector 1. */
extern const struct zelos_ar_pdu ar_dcdc_mux_limits;
#define AR_DCDC_MUX_LIMITS_ID 0x314
#define AR_DCDC_MUX_LIMITS_PERIOD_MS 100
#define AR_DCDC_MUX_LIMITS_OFFSET_MS 50
#define AR_DCDC_MUX_LIMITS_SELECTOR 1
extern const struct zelos_ar_signal ar_dcdc_mux_limits_aux_current_limit;
extern const struct zelos_ar_signal ar_dcdc_mux_limits_setpoint_voltage;

/* DcdcSecured: frame 0x315, SECURED-I-PDU. SecOC profile 1 (24Bit-CMAC-8Bit-FV): payload, 8-bit freshness, 24-bit AES-128 CMAC. */
#define AR_DCDC_SECURED_LENGTH 8
#define AR_DCDC_SECURED_DATA_ID 0x0315
#define AR_DCDC_SECURED_FRESHNESS_BITS 8
#define AR_DCDC_SECURED_FRESHNESS_TX_BITS 8
#define AR_DCDC_SECURED_AUTH_TX_BITS 24
/* DcdcSecuredPayload: the authentic I-PDU of DcdcSecured. */
extern const struct zelos_ar_pdu ar_dcdc_secured_payload;
#define AR_DCDC_SECURED_PAYLOAD_ID 0x315
#define AR_DCDC_SECURED_PAYLOAD_PERIOD_MS 100
#define AR_DCDC_SECURED_PAYLOAD_OFFSET_MS 0
extern const struct zelos_ar_signal ar_dcdc_secured_payload_output_voltage;
extern const struct zelos_ar_signal ar_dcdc_secured_payload_input_current;

#endif /* AUTOSAR_PDUS_H_ */
```

## src/calibration.h
```c
/*
 * What a tool may recalibrate while the node runs: XCP by symbol (dcdc.a2l),
 * UDS by address (src/uds.c, window 0x00020000). Built with `-S xcp` or
 * `-S uds`.
 *
 * Both tools store through dcdc_cal_write(), under one lock, and the model
 * reads the pair under it once per cycle: it never runs on one tool's demand
 * and the other's half-written slew rate. An XCP DOWNLOAD carries at most 6
 * bytes, so XCP writes the two floats separately; each lands whole.
 *
 * Precedence: UDS InputOutputControl (0x2F) on 0x0300 overrides the output
 * voltage setpoint (DID 0x0200) while the tester holds it; neither touches
 * demand or slew rate, which only the calibration sets.
 *
 * Security: UDS writes this memory only in extended with level 0x01; XCP
 * writes it without seed and key. This is a development ECU on a bench: any
 * XCP master on the bus may recalibrate it.
 */

#ifndef DCDC_CALIBRATION_H_
#define DCDC_CALIBRATION_H_

#include <stddef.h>

struct dcdc_calibration {
	/* What the 12 V loads ask of the converter, pack side, A; 0..20. */
	float demand_a;
	/* Rate cap on the pack-side current, A/s; 0.1..100. */
	float slew_a_per_s;
};

/* Defined in dcdc.c. */
extern struct dcdc_calibration dcdc_cal;

/* Store len bytes into dcdc_cal under its lock: the XCP and UDS write hook. */
void dcdc_cal_write(void *dst, const void *src, size_t len);

#endif /* DCDC_CALIBRATION_H_ */
```

## src/dcdc.c
```c
/*
 * DC-DC converter.
 *
 * Steps the high-voltage pack down to the 12 V rail. The pack current it draws
 * is bounded by BMS_Limits.AuxCurrentLimit, which the BMS lowers while the
 * vehicle charges.
 *
 * Draw is slew-rate limited, because snapping the input current to a new
 * setpoint stresses the pack contactors and the input filter.
 */

#include <bench.h>
#include <zelos/can.h>

#include "calibration.h"
#include "dcdc_node.h"

#include <string.h>

#include <zephyr/kernel.h>
#include <zephyr/logging/log.h>

LOG_MODULE_REGISTER(dcdc, LOG_LEVEL_INF);

/* What the 12 V loads ask of the converter, referred to the pack side. */
#define DEMAND_A 4.5f

/* Rate cap on the pack-side current, amps per second. */
#define SLEW_A_PER_S 10.0f

#define RAIL_NOMINAL_V 13.8f
#define RAIL_DROOP_V_PER_A 0.0035f

/* Thermal model: rises with throughput, falls toward ambient. */
#define AMBIENT_C 28.0f
#define THERMAL_GAIN_C_PER_A 4.5f
#define THERMAL_TAU_S 6.0f
#define DERATE_ABOVE_C 70.0f

/* Conversion efficiency, used to turn pack-side current into rail current. */
#define PACK_NOMINAL_V 374.0f
#define EFFICIENCY 0.93f

#if defined(CONFIG_ZELOS_XCP) || defined(CONFIG_ZELOS_UDS)
/*
 * Built with `-S xcp` or `-S uds`, a tool may recalibrate the demand and slew
 * rate while the node runs, so they move from constants into RAM.
 */

struct dcdc_calibration dcdc_cal = {
	.demand_a = DEMAND_A,
	.slew_a_per_s = SLEW_A_PER_S,
};

/* Around every write to dcdc_cal and the model's read of it. */
static struct k_spinlock dcdc_cal_lock;

void dcdc_cal_write(void *dst, const void *src, size_t len)
{
	K_SPINLOCK(&dcdc_cal_lock) {
		memcpy(dst, src, len);
	}
}

/*
 * The node bounds what it was sent rather than trusting the tool to honour its
 * limits. Written so that NaN lands on the lower bound.
 */
static float bounded(float value, float lo, float hi)
{
	return !(value >= lo) ? lo : (value > hi ? hi : value);
}
#endif

#if defined(CONFIG_ZELOS_XCP)
#include "xcp.h"
#endif

#if defined(CONFIG_ZELOS_UDS) || defined(CONFIG_ZELOS_AUTOSAR)
/*
 * Built with `-S uds` or `-S autosar`, the node reports each cycle's state,
 * the pack voltage it sees among it. See src/state.h.
 */
#define DCDC_STATE

#include <math.h>

#include "state.h"

/* A BMS frame older than this is missing. */
#define BMS_TIMEOUT_MS (5 * BENCH_BMS_LIMITS_CYCLE_TIME_MS)

K_MSGQ_DEFINE(dcdc_pack_msgq, sizeof(struct can_frame), 4, 4);

static int64_t pack_at_ms;
static float pack_v;

/* The latest BMS_Status.PackVoltage; NaN when there is none fresh. */
static float latest_pack_v(bool apply, int64_t now)
{
	struct can_frame frame;
	struct bench_bms_status_t pack;

	while (k_msgq_get(&dcdc_pack_msgq, &frame, K_NO_WAIT) == 0) {
		if (apply && bench_bms_status_unpack(&pack, frame.data,
						     can_dlc_to_bytes(frame.dlc)) == 0) {
			pack_v = bench_bms_status_pack_voltage_decode(pack.pack_voltage);
			pack_at_ms = now;
		}
	}
	return pack_at_ms != 0 && now - pack_at_ms <= BMS_TIMEOUT_MS ? pack_v : NAN;
}
#endif

#if defined(CONFIG_ZELOS_UDS)
/*
 * Built with `-S uds`, a tester sets the output voltage, controls the node's
 * communication and reads its state and DTCs. See src/uds.c.
 */
#include <zelos/uds.h>

#include "uds.h"

static int64_t limits_at_ms;
#endif

#if defined(CONFIG_ZELOS_AUTOSAR)
/* Built with `-S autosar`, the node sends its AUTOSAR PDUs. See src/autosar.c. */
#include "autosar.h"
#endif

#if defined(CONFIG_ZELOS_SOMEIP)
/* Built with `-S ethernet`, the node is a SOME/IP service. See src/someip.c. */
#include "someip.h"
#endif

#if defined(CONFIG_ZELOS_GOOSE)
/* Built with `-S goose`, the latest cycle for GOOSE (nodes/full). */
static struct k_spinlock latest_lock;
static struct dcdc_sample latest;

void dcdc_latest(struct dcdc_sample *out)
{
	K_SPINLOCK(&latest_lock) {
		*out = latest;
	}
}
#endif

/* Demand and slew rate, as one pair: a tool's write lands whole or not yet. */
static struct dcdc_calibration calibration(void)
{
#if defined(CONFIG_ZELOS_XCP) || defined(CONFIG_ZELOS_UDS)
	struct dcdc_calibration cal;

	K_SPINLOCK(&dcdc_cal_lock) {
		cal = dcdc_cal;
	}
	cal.demand_a = bounded(cal.demand_a, 0.0f, 20.0f);
	cal.slew_a_per_s = bounded(cal.slew_a_per_s, 0.1f, 100.0f);
	return cal;
#else
	return (struct dcdc_calibration){.demand_a = DEMAND_A, .slew_a_per_s = SLEW_A_PER_S};
#endif
}

/* The rail's no-load voltage. */
static float rail_nominal_v(void)
{
#if defined(CONFIG_ZELOS_UDS)
	return dcdc_uds_output_v();
#else
	return RAIL_NOMINAL_V;
#endif
}

K_MSGQ_DEFINE(dcdc_limits_msgq, sizeof(struct can_frame), 4, 4);

/* Frames are drained either way; applied only while reception is enabled. */
static float latest_aux_limit(float current_limit_a, bool apply)
{
	struct can_frame frame;
	struct bench_bms_limits_t limits;

	while (k_msgq_get(&dcdc_limits_msgq, &frame, K_NO_WAIT) == 0) {
		if (apply && bench_bms_limits_unpack(&limits, frame.data,
						     can_dlc_to_bytes(frame.dlc)) == 0) {
			current_limit_a = bench_bms_limits_aux_current_limit_decode(
				limits.aux_current_limit);
#if defined(CONFIG_ZELOS_UDS)
			limits_at_ms = k_uptime_get();
#endif
		}
	}

	return current_limit_a;
}

static void run(void *p1, void *p2, void *p3);

/*
 * The control loop, on a thread of its own so an image can run it beside other
 * nodes; main()'s priority and stack, where it ran before.
 */
K_THREAD_DEFINE(dcdc_tid, 1024, run, NULL, NULL, NULL, 0, 0, SYS_FOREVER_MS);

int dcdc_start(void)
{
	if (zelos_can_subscribe(BENCH_BMS_LIMITS_FRAME_ID, &dcdc_limits_msgq) < 0) {
		LOG_ERR("subscribe to BMS_Limits failed");
		return -EIO;
	}

#if defined(DCDC_STATE)
	/* The pack voltage: the input undervoltage DTC, the AUTOSAR PDUs. */
	if (zelos_can_subscribe(BENCH_BMS_STATUS_FRAME_ID, &dcdc_pack_msgq) < 0) {
		LOG_ERR("subscribe to BMS_Status failed");
		return -EIO;
	}
#endif

#if defined(CONFIG_ZELOS_XCP)
	if (dcdc_xcp_start() != 0) {
		return -EIO;
	}
#endif

#if defined(CONFIG_ZELOS_UDS)
	if (dcdc_uds_start() != 0) {
		return -EIO;
	}
#endif

#if defined(CONFIG_ZELOS_AUTOSAR)
	if (dcdc_autosar_start() != 0) {
		return -EIO;
	}
#endif

#if defined(CONFIG_ZELOS_SOMEIP)
	if (dcdc_someip_start() != 0) {
		return -EIO;
	}
#endif

	LOG_INF("DC-DC up, %u ms cycle, slew %d A/s", BENCH_DCDC_STATUS_CYCLE_TIME_MS,
		(int)calibration().slew_a_per_s);

	k_thread_start(dcdc_tid);

	return 0;
}

static void run(void *p1, void *p2, void *p3)
{
	const float dt_s = (float)BENCH_DCDC_STATUS_CYCLE_TIME_MS / 1000.0f;
	float input_current_a = 0.0f;
	float aux_limit_a = 0.0f;
	float temperature_c = AMBIENT_C;
	uint8_t counter = 0U;
	int64_t deadline;
#if defined(CONFIG_ZELOS_UDS)
	bool rx_was = true;
#endif

	ARG_UNUSED(p1);
	ARG_UNUSED(p2);
	ARG_UNUSED(p3);

	deadline = k_uptime_get();

	for (;;) {
		struct bench_dcdc_status_t status = {0};
		uint8_t buf[BENCH_DCDC_STATUS_LENGTH];
		/* Per cycle, because XCP and UDS can recalibrate both. */
		const struct dcdc_calibration cal = calibration();
		const float slew_step_a = cal.slew_a_per_s * dt_s;
		float setpoint_a;
		float rail_current_a;
		float rail_voltage_v;
#if defined(CONFIG_ZELOS_UDS)
		/* CommunicationControl: the application's normal messages only. */
		const bool rx = zelos_uds_rx_enabled();
		const bool tx = zelos_uds_tx_enabled();
#else
		const bool rx = true;
		const bool tx = true;
#endif
#if defined(DCDC_STATE)
		const int64_t now = k_uptime_get();
		const float input_v = latest_pack_v(rx, now);
#endif
#if defined(CONFIG_ZELOS_UDS)
		/* Reception back on: the BMS timeout runs from here, not the last frame before. */
		if (rx && !rx_was) {
			limits_at_ms = now;
		}
		rx_was = rx;
#endif

		aux_limit_a = latest_aux_limit(aux_limit_a, rx);

		/* Never ask for more than the loads need, or more than the pack allows. */
		setpoint_a = MIN(cal.demand_a, aux_limit_a);

		/*
		 * Approach the setpoint. Increases are always rate-capped.
		 * Whether reductions are too is the only difference between this
		 * node's two builds; see nodes/dcdc/Kconfig.
		 */
		if (setpoint_a < input_current_a) {
			if (IS_ENABLED(CONFIG_BENCH_DCDC_HONOUR_LIMIT_IMMEDIATELY)) {
				input_current_a = setpoint_a;
			} else {
				input_current_a = MAX(input_current_a - slew_step_a, setpoint_a);
			}
		} else {
			input_current_a = MIN(input_current_a + slew_step_a, setpoint_a);
		}

		rail_current_a =
			input_current_a * PACK_NOMINAL_V * EFFICIENCY / rail_nominal_v();

		temperature_c += ((AMBIENT_C + THERMAL_GAIN_C_PER_A * input_current_a) -
				  temperature_c) *
				 (dt_s / THERMAL_TAU_S);

		rail_voltage_v = rail_nominal_v() - RAIL_DROOP_V_PER_A * rail_current_a;

#if defined(CONFIG_ZELOS_XCP)
		dcdc_xcp_sample(setpoint_a, input_current_a, slew_step_a, temperature_c,
				aux_limit_a);
#endif
#if defined(DCDC_STATE)
		const struct dcdc_state state = {
			.output_v = rail_voltage_v,
			.output_a = rail_current_a,
			.input_v = input_v,
			.input_a = input_current_a,
			.temperature_c = temperature_c,
			.setpoint_v = rail_nominal_v(),
			.aux_limit_a = aux_limit_a,
			.uptime_ms = (uint32_t)now,
		};
#endif
#if defined(CONFIG_ZELOS_UDS)
		dcdc_uds_sample(&state,
				/*
				 * Monitored while reception is on, from the first
				 * frame or the first timeout, whichever comes first.
				 */
				rx && (limits_at_ms != 0 || now > BMS_TIMEOUT_MS),
				now - limits_at_ms > BMS_TIMEOUT_MS);
#endif
#if defined(CONFIG_ZELOS_AUTOSAR)
		dcdc_autosar_sample(&state, temperature_c > DERATE_ABOVE_C, tx);
#endif

		status.output_voltage = bench_dcdc_status_output_voltage_encode(rail_voltage_v);
		status.output_current = bench_dcdc_status_output_current_encode(rail_current_a);
		status.input_current = bench_dcdc_status_input_current_encode(input_current_a);
		status.temperature = bench_dcdc_status_temperature_encode(temperature_c);
		status.derate_active = temperature_c > DERATE_ABOVE_C
					       ? BENCH_DCDC_STATUS_DERATE_ACTIVE_ACTIVE_CHOICE
					       : BENCH_DCDC_STATUS_DERATE_ACTIVE_INACTIVE_CHOICE;
		status.counter = counter & 0x7FU;
#if defined(CONFIG_ZELOS_GOOSE)
		K_SPINLOCK(&latest_lock) {
			latest = (struct dcdc_sample){
				.output_v = rail_voltage_v,
				.output_a = rail_current_a,
				.input_a = input_current_a,
				.temperature_c = temperature_c,
				.derating = temperature_c > DERATE_ABOVE_C,
				.cycles = latest.cycles + 1U,
			};
		}
#endif
#if defined(CONFIG_ZELOS_SOMEIP)
		/* The same sample and Counter as this cycle's DCDC_Status. */
		dcdc_someip_sample(&state, temperature_c > DERATE_ABOVE_C, status.counter);
#endif

		if (bench_dcdc_status_pack(buf, &status, sizeof(buf)) != (int)sizeof(buf)) {
			LOG_ERR("pack failed");
			return;
		}

		/* The counter counts frames sent, so a gap in it is a reset. */
		if (tx) {
			(void)zelos_can_send(BENCH_DCDC_STATUS_FRAME_ID, buf, sizeof(buf));
			counter++;
		}

		deadline += BENCH_DCDC_STATUS_CYCLE_TIME_MS;
		k_sleep(K_TIMEOUT_ABS_MS(deadline));
	}
}
```

## src/dcdc_node.h
```c
#ifndef DCDC_NODE_H_
#define DCDC_NODE_H_

#include <stdbool.h>
#include <stdint.h>

/**
 * Subscribe, start XCP and UDS if built in, and start the control loop.
 * Needs zelos_can_init() first.
 *
 * @return 0, or negative errno.
 */
int dcdc_start(void);

#if defined(CONFIG_ZELOS_GOOSE)
/* The latest cycle, as DCDC_Status encodes it, and cycles run since start. */
struct dcdc_sample {
	float output_v;
	float output_a;
	float input_a;
	float temperature_c;
	bool derating;
	uint32_t cycles;
};

/* From any thread. */
void dcdc_latest(struct dcdc_sample *out);
#endif

#endif /* DCDC_NODE_H_ */
```

## src/someip.c
```c
/*
 * The DC-DC as a SOME/IP service, as arxml/can-full.arxml describes it:
 * DcdcService 0x5A00, instance 1, version 1.0, on UDP 30509, eventgroup 1.
 *
 *   Event DcdcStatus 0x8001, every 100 ms, 26 bytes, big-endian: output V,
 *   output A, input V (NaN with no fresh BMS_Status), input A, temperature
 *   degC (float32 each), DcdcState (uint8: 0 Idle, 1 Converting, 2 Derating,
 *   as the AUTOSAR PDUs), the DCDC_Status Counter of the same sample (uint8),
 *   uptime ms (uint32).
 *   Field Setpoint: UDS DID 0x0200, uint16 10 mV. Getter 0x0001, notifier
 *   0x8002. No setter: writes go through UDS, behind security access.
 *
 * CommunicationControl (0x28) stops the event and the notifier, as it stops
 * DCDC_Status; SD and the getter go on.
 */

#include "someip.h"

#include <string.h>

#include <zelos/someip.h>
#include <zelos/uds.h>

#include <zephyr/kernel.h>
#include <zephyr/sys/byteorder.h>

#include "uds.h"

BUILD_ASSERT(IS_ENABLED(CONFIG_ZELOS_UDS), "the Setpoint field is UDS's DID 0x0200");

enum { IDLE, CONVERTING, DERATING };

static struct k_spinlock lock;
static struct dcdc_state latest;
static uint8_t latest_state;
static uint8_t latest_counter;
static bool sampled;

void dcdc_someip_sample(const struct dcdc_state *state, bool derating, uint8_t counter)
{
	const uint8_t mode = derating ? DERATING : state->input_a > 0.0f ? CONVERTING : IDLE;
	k_spinlock_key_t key = k_spin_lock(&lock);

	latest = *state;
	latest_state = mode;
	latest_counter = counter;
	sampled = true;
	k_spin_unlock(&lock, key);
}

static uint8_t *put_f32(uint8_t *p, float v)
{
	uint32_t bits;

	memcpy(&bits, &v, sizeof(bits));
	sys_put_be32(bits, p);
	return p + 4;
}

static bool read_status(uint8_t *out)
{
	k_spinlock_key_t key = k_spin_lock(&lock);
	const struct dcdc_state s = latest;
	const uint8_t mode = latest_state;
	const uint8_t counter = latest_counter;
	const bool have = sampled;

	k_spin_unlock(&lock, key);
	if (!have) {
		return false;
	}
	out = put_f32(out, s.output_v);
	out = put_f32(out, s.output_a);
	out = put_f32(out, s.input_v);
	out = put_f32(out, s.input_a);
	out = put_f32(out, s.temperature_c);
	out[0] = mode;
	out[1] = counter;
	sys_put_be32(s.uptime_ms, &out[2]);
	return true;
}

static void read_setpoint(uint8_t *out)
{
	sys_put_be16(dcdc_uds_setpoint(), out);
}

static bool may_notify(void)
{
	return zelos_uds_tx_enabled();
}

static const struct zelos_someip_event events[] = {
	{.id = 0x8001, .cycle_ms = 100, .size = 26, .read = read_status},
};

static const struct zelos_someip_field fields[] = {
	{.getter = 0x0001, .notifier = 0x8002, .size = 2, .read = read_setpoint},
};

static const struct zelos_someip_service service = {
	.service = 0x5A00,
	.instance = 0x0001,
	.major = 1,
	.minor = 0,
	.port = 30509,
	.eventgroup = 0x0001,
	.events = events,
	.event_count = ARRAY_SIZE(events),
	.fields = fields,
	.field_count = ARRAY_SIZE(fields),
	.may_notify = may_notify,
};

int dcdc_someip_start(void)
{
	return zelos_someip_offer(&service);
}
```

## src/someip.h
```c
/* The DC-DC's SOME/IP service, with lib/someip. */

#ifndef DCDC_SOMEIP_H_
#define DCDC_SOMEIP_H_

#include <stdbool.h>
#include <stdint.h>

#include "state.h"

int dcdc_someip_start(void);

/* This cycle's state, with the DCDC_Status Counter of the same sample. */
void dcdc_someip_sample(const struct dcdc_state *state, bool derating, uint8_t counter);

#endif /* DCDC_SOMEIP_H_ */
```

## src/state.h
```c
/*
 * One cycle of the DC-DC model, as UDS and AUTOSAR report it. Also UDS's
 * read-only memory window at 0x00010000, as is: 32 bytes, little-endian.
 */

#ifndef DCDC_STATE_H_
#define DCDC_STATE_H_

#include <stdint.h>

struct dcdc_state {
	float output_v;
	float output_a;
	/* Pack voltage from BMS_Status; NaN when none is fresh. */
	float input_v;
	float input_a;
	float temperature_c;
	float setpoint_v;
	float aux_limit_a;
	uint32_t uptime_ms;
};

#endif /* DCDC_STATE_H_ */
```

## src/uds.h
```c
/* The DC-DC's UDS view, built with `-S uds`. */

#ifndef DCDC_UDS_H_
#define DCDC_UDS_H_

#include <stdbool.h>
#include <stdint.h>

#include "state.h"

int dcdc_uds_start(void);

/* The output voltage to regulate to: the tester's, or the setpoint DID's. */
float dcdc_uds_output_v(void);

/* DID 0x0200, the output voltage setpoint, 10 mV. */
uint16_t dcdc_uds_setpoint(void);

/*
 * Publish this cycle's state and run the DTC tests on it. The BMS timeout test
 * runs only while monitored.
 */
void dcdc_uds_sample(const struct dcdc_state *state, bool bms_monitored, bool bms_lost);

#endif /* DCDC_UDS_H_ */
```
