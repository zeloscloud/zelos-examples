## CMakeLists.txt
```
cmake_minimum_required(VERSION 3.20.0)
# XCP, UDS, AUTOSAR, Ethernet and GOOSE are part of this image, so their snippets apply without -S.
set(SNIPPET xcp uds autosar ethernet goose CACHE STRING "Snippets every build of this image takes")
find_package(Zephyr REQUIRED HINTS $ENV{ZEPHYR_BASE})
project(full)

# One MCU, three logical ECUs, from the single-node apps' own sources: the
# DC-DC with XCP, UDS and AUTOSAR PDUs, the genset (J1939) and the PDU (CANopen).
set(nodes ${CMAKE_CURRENT_SOURCE_DIR}/..)
zephyr_include_directories(${nodes}/pdu/od)
target_sources(app PRIVATE
  src/main.c src/waveform.c
  ${nodes}/dcdc/src/dcdc.c ${nodes}/dcdc/src/xcp.c ${nodes}/dcdc/src/uds.c
  ${nodes}/dcdc/src/autosar.c ${nodes}/dcdc/src/autosar_pdus.c
  ${nodes}/genset/src/genset.c
  ${nodes}/pdu/src/pdu.c ${nodes}/pdu/od/CO_OD.c
)
target_sources_ifdef(CONFIG_ZELOS_SOMEIP app PRIVATE ${nodes}/dcdc/src/someip.c)
target_sources_ifdef(CONFIG_ZELOS_GOOSE app PRIVATE src/goose.c)
# zephyr/dcdc.a2l, the DC-DC's A2L with this image's addresses.
zelos_xcp_a2l(${nodes}/dcdc/dcdc.a2l)
```

## Kconfig
```
# The DC-DC's build option, which this image builds with too.
rsource "../dcdc/Kconfig.node"

source "Kconfig.zephyr"
```

## sample.yaml
```
sample:
  name: Combined bench image (DC-DC + XCP + UDS + AUTOSAR + Ethernet + GOOSE, genset J1939, PDU CANopen)
common:
  platform_allow: nucleo_h753zi
  integration_platforms:
    - nucleo_h753zi
tests:
  zelos.nodes.full:
    required_snippets:
      - xcp
      - uds
      - autosar
      - ethernet
      - goose
```

## prj.conf
```kconfig
# Every protocol on one controller: the union of nodes/dcdc and nodes/pdu, plus
# the genset (nodes/genset/src, built only here), with XCP, UDS and AUTOSAR by
# their snippets (see CMakeLists.txt).
CONFIG_CAN=y
CONFIG_LOG=y

CONFIG_ZELOS_CAN=y
CONFIG_ZELOS_CODEC_BENCH=y
CONFIG_ZELOS_CODEC_GENSET=y
CONFIG_ZELOS_J1939=y
CONFIG_ZELOS_CANOPEN=y

# As nodes/pdu has them.
CONFIG_CANOPENNODE_LEDS=n
CONFIG_CANOPENNODE_SDO_BUFFER_SIZE=889

# RX FIFO overruns, for the coexistence suite (UDS DID 0x0110).
CONFIG_STATS=y
CONFIG_CAN_STATS=y

# zelos_goose_start() encodes a trial frame on main's stack, about 1 KB.
CONFIG_MAIN_STACK_SIZE=2048
```

## boards/nucleo_h753zi.overlay
```dts
/* One message RAM layout for every node: see the included file. */
#include "../../../lib/can/boards/nucleo_h753zi.dtsi"
```

## src/main.c
```c
/*
 * One MCU hosting three logical ECUs on one controller: the DC-DC (with XCP,
 * UDS and AUTOSAR PDUs), the genset (J1939) and the PDU (CANopen). lib/can
 * brings the bus up once; each node then starts its own threads. A signal
 * generator (nodes/full/src/waveform.c) adds a chirped Waveform frame for plots.
 * Ethernet (lib/eth) comes up beside them, at 10.1.1.75 by default, with
 * GOOSE (lib/goose, nodes/full/src/goose.c) on it.
 *
 * The UDS server is the DC-DC's: CommunicationControl and ControlDTCSetting
 * act on the DC-DC alone. ECUReset reboots the MCU, so every node restarts.
 */

#include <zelos/can.h>
#include <zelos/eth.h>

#include <zephyr/logging/log.h>

#include "../../dcdc/src/dcdc_node.h"
#include "../../genset/src/genset_node.h"
#include "../../pdu/src/pdu_node.h"
#include "goose.h"
#include "waveform.h"

LOG_MODULE_REGISTER(full, LOG_LEVEL_INF);

int main(void)
{
	if (zelos_can_init() != 0) {
		return 0;
	}

	/* Each logs its own failure; the others still start. */
	(void)dcdc_start();
	(void)genset_start();
	(void)pdu_start();
	(void)waveform_start();
#if defined(CONFIG_ZELOS_ETH)
	/* Last, and it never waits: CAN starts as it would with no cable. */
	(void)zelos_eth_start();
#endif
#if defined(CONFIG_ZELOS_GOOSE)
	(void)full_goose_start();
#endif

	return 0;
}
```

## src/goose.c
```c
/*
 * The image's GOOSE (lib/goose): logical device ZELOSFULL, logical node LLN0,
 * confRev 1, no VLAN.
 *
 *   gcb_pdu, APPID 0x0001 to 01:0C:CD:01:00:01, data set ds_pdu, goID
 *   zelos-pdu, on change: the PDU's channels 1-8 powered (Dbpos, on 10 closed,
 *   off 01 open), their trip latches 1-8 (BOOLEAN), then overcurrent EMCYs
 *   since boot (INT32).
 *   gcb_dcdc, APPID 0x0002 to 01:0C:CD:01:00:02, data set ds_dcdc, goID
 *   zelos-dcdc, every 100 ms: the DC-DC's output V, output A, input A and
 *   temperature degC (FLOAT32), then its 50 ms cycles since start (UNSIGNED).
 *   Its members move between frames, so each frame is a new state: stNum + 1,
 *   sqNum 0.
 *
 * The user button (sw0) toggles PDU channel 1's commanded state, 50 ms after
 * the last edge if still pressed.
 */

#include "goose.h"

#include <zelos/goose.h>

#include <zephyr/drivers/gpio.h>
#include <zephyr/kernel.h>
#include <zephyr/logging/log.h>

#include "../../dcdc/src/dcdc_node.h"
#include "../../pdu/src/pdu_node.h"

LOG_MODULE_REGISTER(full_goose, LOG_LEVEL_INF);

#define CHANNELS 8
#define DEBOUNCE_MS 50
#define DCDC_MEMBERS 5

static uint32_t read_pdu(struct zelos_goose_value *v)
{
	uint8_t powered;
	uint8_t tripped;
	int32_t emcy;

	pdu_status(&powered, &tripped, &emcy);
	for (int ch = 0; ch < CHANNELS; ch++) {
		v[ch] = (struct zelos_goose_value){
			.type = ZELOS_GOOSE_DBPOS,
			.dbpos = (powered & BIT(ch)) != 0U ? ZELOS_GOOSE_ON : ZELOS_GOOSE_OFF,
		};
		v[CHANNELS + ch] = (struct zelos_goose_value){
			.type = ZELOS_GOOSE_BOOLEAN,
			.boolean = (tripped & BIT(ch)) != 0U,
		};
	}
	v[2 * CHANNELS] = (struct zelos_goose_value){.type = ZELOS_GOOSE_INT32, .i32 = emcy};
	/* Every member; the EMCY count's low 16 bits are plenty between two reads. */
	return powered | tripped << 8 | (uint32_t)emcy << 16;
}

static uint32_t read_dcdc(struct zelos_goose_value *v)
{
	struct dcdc_sample s;
	uint32_t state = 2166136261U;

	dcdc_latest(&s);
	v[0] = (struct zelos_goose_value){.type = ZELOS_GOOSE_FLOAT32, .f32 = s.output_v};
	v[1] = (struct zelos_goose_value){.type = ZELOS_GOOSE_FLOAT32, .f32 = s.output_a};
	v[2] = (struct zelos_goose_value){.type = ZELOS_GOOSE_FLOAT32, .f32 = s.input_a};
	v[3] = (struct zelos_goose_value){.type = ZELOS_GOOSE_FLOAT32, .f32 = s.temperature_c};
	v[4] = (struct zelos_goose_value){.type = ZELOS_GOOSE_UINT32, .u32 = s.cycles};
	/* Every member's bits, folded (FNV-1a): any member's change is a new state. */
	for (int i = 0; i < DCDC_MEMBERS; i++) {
		state = (state ^ v[i].u32) * 16777619U;
	}
	return state;
}

static const struct zelos_goose_cb cbs[] = {
	{
		.appid = 0x0001,
		.dst = {0x01, 0x0C, 0xCD, 0x01, 0x00, 0x01},
		.gocb_ref = "ZELOSFULL/LLN0$GO$gcb_pdu",
		.dat_set = "ZELOSFULL/LLN0$ds_pdu",
		.go_id = "zelos-pdu",
		.count = 2 * CHANNELS + 1,
		.read = read_pdu,
	},
	{
		.appid = 0x0002,
		.dst = {0x01, 0x0C, 0xCD, 0x01, 0x00, 0x02},
		.gocb_ref = "ZELOSFULL/LLN0$GO$gcb_dcdc",
		.dat_set = "ZELOSFULL/LLN0$ds_dcdc",
		.go_id = "zelos-dcdc",
		.period_ms = 100,
		.count = DCDC_MEMBERS,
		.read = read_dcdc,
	},
};

static const struct gpio_dt_spec button = GPIO_DT_SPEC_GET(DT_ALIAS(sw0), gpios);
static struct gpio_callback button_cb;

static void pressed(struct k_work *work)
{
	ARG_UNUSED(work);
	if (gpio_pin_get_dt(&button) == 1) {
		LOG_INF("button: channel 1 toggled");
		pdu_toggle_output(1);
	}
}

static K_WORK_DELAYABLE_DEFINE(debounce, pressed);

static void edge(const struct device *dev, struct gpio_callback *cb, uint32_t pins)
{
	ARG_UNUSED(dev);
	ARG_UNUSED(cb);
	ARG_UNUSED(pins);
	(void)k_work_reschedule(&debounce, K_MSEC(DEBOUNCE_MS));
}

int full_goose_start(void)
{
	/* No button, no toggle: GOOSE goes on. */
	if (!gpio_is_ready_dt(&button) || gpio_pin_configure_dt(&button, GPIO_INPUT) != 0 ||
	    gpio_pin_interrupt_configure_dt(&button, GPIO_INT_EDGE_BOTH) != 0) {
		LOG_WRN("user button unavailable");
	} else {
		gpio_init_callback(&button_cb, edge, BIT(button.pin));
		(void)gpio_add_callback(button.port, &button_cb);
	}
	return zelos_goose_start(cbs, ARRAY_SIZE(cbs));
}
```

## src/goose.h
```c
/* The image's GOOSE control blocks and the user button, with lib/goose. */

#ifndef FULL_GOOSE_H_
#define FULL_GOOSE_H_

/** Start publishing once the link is up. 0, or negative errno. */
int full_goose_start(void);

#endif /* FULL_GOOSE_H_ */
```

## src/waveform.c
```c
/*
 * A signal generator for plots: Waveform (0x7F0) at 500 Hz carrying sine,
 * square and sawtooth of one phase, the frequency swept 1 -> 100 Hz over 20 s
 * and wrapped. The lowest-priority ID on the bus, so it yields to every node.
 * No libm: the sine table is built once by rotating a unit vector.
 */

#include <bench.h>
#include <zelos/can.h>

#include "waveform.h"

#include <zephyr/kernel.h>
#include <zephyr/sys/atomic.h>
#include <zephyr/logging/log.h>

LOG_MODULE_REGISTER(waveform, LOG_LEVEL_INF);

#define PERIOD_MS   BENCH_WAVEFORM_CYCLE_TIME_MS
#define F0_HZ       1.0f
#define F1_HZ       100.0f
#define SWEEP_MS    20000
#define TABLE_BITS  8
#define TABLE_SIZE  (1 << TABLE_BITS)

static float sine_table[TABLE_SIZE];

static void build_table(void)
{
	/* cos and sin of 2*pi/256; the recurrence drifts ~1e-5 over one turn. */
	const float c = 0.99969881869620f;
	const float s = 0.02454122852291f;
	float x = 1.0f;
	float y = 0.0f;

	for (int i = 0; i < TABLE_SIZE; i++) {
		sine_table[i] = y;
		float nx = x * c - y * s;
		y = x * s + y * c;
		x = nx;
	}
}

static atomic_t in_flight;

static void left(struct zelos_can_done *done, int error)
{
	ARG_UNUSED(done);
	ARG_UNUSED(error);
	atomic_clear(&in_flight);
}

static struct zelos_can_done sent = {.fn = left};

static void run(void *p1, void *p2, void *p3)
{
	const float dt_s = (float)PERIOD_MS / 1000.0f;
	uint32_t phase = 0U; /* one turn = 2^32 */
	int64_t deadline;
	int64_t t0;

	ARG_UNUSED(p1);
	ARG_UNUSED(p2);
	ARG_UNUSED(p3);

	build_table();
	deadline = t0 = k_uptime_get();

	for (;;) {
		struct bench_waveform_t msg = {0};
		uint8_t buf[BENCH_WAVEFORM_LENGTH];
		const int64_t t_ms = (deadline - t0) % SWEEP_MS;
		const float f_hz = F0_HZ + (F1_HZ - F0_HZ) * (float)t_ms / (float)SWEEP_MS;
		const float frac = (float)phase / 4294967296.0f;
		const float sine = sine_table[phase >> (32 - TABLE_BITS)];

		/* Raw units (0.01 Hz, 0.001), rounded: the encoders truncate. */
		msg.freq_hz = (uint16_t)(f_hz * 100.0f + 0.5f);
		msg.sine = (int16_t)(sine * 1000.0f + (sine < 0.0f ? -0.5f : 0.5f));
		msg.square = frac < 0.5f ? 1000 : -1000;
		msg.sawtooth = (int16_t)(2000.0f * frac - 1000.0f);

		/* One frame in flight at most, else under load Waveform fills the
		 * controller's TX buffer and higher-priority frames wait on it.
		 * A busy bus costs samples, not the other nodes' periods. */
		if (atomic_cas(&in_flight, 0, 1)) {
			if (bench_waveform_pack(buf, &msg, sizeof(buf)) == (int)sizeof(buf)) {
				(void)zelos_can_send_done(BENCH_WAVEFORM_FRAME_ID, buf, sizeof(buf), &sent);
			} else {
				atomic_clear(&in_flight);
			}
		}

		phase += (uint32_t)(f_hz * dt_s * 4294967296.0f);
		deadline += PERIOD_MS;
		k_sleep(K_TIMEOUT_ABS_MS(deadline));
	}
}

K_THREAD_DEFINE(waveform_tid, 1024, run, NULL, NULL, NULL, 2, 0, SYS_FOREVER_MS);

int waveform_start(void)
{
	k_thread_start(waveform_tid);
	LOG_INF("Waveform 0x%03x every %u ms, %d-%d Hz chirp", BENCH_WAVEFORM_FRAME_ID,
		PERIOD_MS, (int)F0_HZ, (int)F1_HZ);
	return 0;
}
```

## src/waveform.h
```c
#ifndef WAVEFORM_H_
#define WAVEFORM_H_

/**
 * Start the signal generator: Waveform (0x7F0) every 2 ms, one phase chirped
 * 1 to 100 Hz over 20 s as sine, square and sawtooth. Needs zelos_can_init().
 *
 * @return 0.
 */
int waveform_start(void);

#endif /* WAVEFORM_H_ */
```
