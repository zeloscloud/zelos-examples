## CMakeLists.txt
```
cmake_minimum_required(VERSION 3.20.0)
find_package(Zephyr REQUIRED HINTS $ENV{ZEPHYR_BASE})
project(genset)

target_sources(app PRIVATE src/main.c src/genset.c)
```

## sample.yaml
```
sample:
  name: Range-extender genset ECU (J1939)
common:
  platform_allow: nucleo_h753zi
  integration_platforms:
    - nucleo_h753zi
tests:
  zelos.nodes.genset: {}
```

## prj.conf
```kconfig
# Classic CAN, 8-byte frames with 29-bit identifiers.
CONFIG_CAN=y

# Each node logs what it is on startup.
CONFIG_LOG=y

# A J1939 ECU by nature, so J1939 is on here rather than by snippet. The bench
# codec reads the VCU's mode, which sets the load; the genset codec packs EEC1
# and ET1.
CONFIG_ZELOS_CAN=y
CONFIG_ZELOS_CODEC_BENCH=y
CONFIG_ZELOS_CODEC_GENSET=y
CONFIG_ZELOS_J1939=y
```

## src/main.c
```c
#include <zelos/can.h>

#include "genset_node.h"

int main(void)
{
	if (zelos_can_init() == 0) {
		(void)genset_start();
	}

	return 0;
}
```

## src/genset_node.h
```c
#ifndef GENSET_NODE_H_
#define GENSET_NODE_H_

/**
 * Subscribe to VCU_Command, start J1939 and the engine model.
 * Needs zelos_can_init() first.
 *
 * @return 0, or negative errno.
 */
int genset_start(void);

#endif /* GENSET_NODE_H_ */
```
